## esp32/main/Kconfig.projbuild
```kconfig
menu "watch-os"

    config WATCH_WIFI_SSID
        string "Wi-Fi SSID"
        default ""
        help
            Имя сети Wi-Fi (только 2.4 ГГц). Пусто - Wi-Fi не включается.
            Это временный способ до приложения «Настройки». Сети с входом через
            страницу авторизации (captive portal, Госуслуги) не поддерживаются.

    config WATCH_WIFI_PASSWORD
        string "Wi-Fi password"
        default ""

    config WATCH_BRIGHTNESS
        int "Яркость экрана, %"
        default 70
        range 5 100
        help
            После инициализации BSP яркость равна 0, экран чёрный, пока её не задать.

    config WATCH_LVGL_STACK
        int "Размер стека задачи LVGL, байт"
        default 16384
        range 8192 65536
        help
            Сетевые запросы (TLS) и разбор JSON выполняются в задаче LVGL, стека по умолчанию мало.

    config WATCH_LCD_FULL_BUFFER
        bool "Буфер отрисовки размером с экран (в PSRAM)"
        default n
        help
            Вместо двух буферов по 20 строк во внутренней памяти (кадр уходит на экран ~26 порциями,
            при прокрутке видны толстые полосы, как на старых экранах) кадр рисуется целиком
            и уходит на экран одной передачей. Мелкие обновления (часы) по-прежнему рисуют только
            свою область. Занимает ~800 КБ PSRAM и освобождает ~33 КБ внутренней памяти.
            Если на часах появятся сбои изображения, выключите и вернитесь к прежнему режиму.

    config WATCH_POWER_SAVE
        bool "Экономия энергии (аккумулятор 400 мА·ч)"
        default y
        help
            Динамическая частота процессора (нужен CONFIG_PM_ENABLE) и максимальный сон модема Wi-Fi
            (просыпается раз в ~1 с, уведомления с телефона приходят с задержкой до секунды).

    config WATCH_CPU_MIN_MHZ
        int "Минимальная частота процессора, МГц"
        depends on WATCH_POWER_SAVE
        default 80
        range 40 240
        help
            Допустимые значения для ESP32-S3: 40 (XTAL), 80, 160, 240.

    config WATCH_LIGHT_SLEEP
        bool "Лёгкий сон между событиями (экспериментально)"
        depends on WATCH_POWER_SAVE
        default n
        help
            Сильнее экономит, но на этой плате не проверялся: может ломать касание, звук и отрисовку.
            Включайте, только если готовы проверить.

    config WATCH_SCREEN_OFF_SLEEP
        bool "При выключенном экране: лёгкий сон и 160 МГц"
        depends on WATCH_POWER_SAVE
        default y
        help
            Пока экран погашен, включается light sleep (Wi-Fi остаётся подключённым и просыпается на маяки),
            максимум частоты 160 МГц, опрос касания раз в 100 мс. При включении экрана всё возвращается.
            Нужен CONFIG_FREERTOS_USE_TICKLESS_IDLE. Если мешает звуку или касанию, выключите.

    config WATCH_PERF_LOG
        bool "Печатать в лог скорость отрисовки"
        default n
        help
            Раз в 5 секунд печатает время отрисовки и оценку WATCH_EMU_US_PER_PX для эмулятора
            (см. esp32/README.md, "Калибровка эмулятора"). Для обычной работы выключите.

    config WATCH_NTP
        bool "Автоматическая синхронизация времени по сети (SNTP)"
        default y
        help
            Когда часы получают IP по Wi-Fi, они спрашивают точное время у NTP-сервера, ставят его и пишут в RTC
            (оно переживает перезагрузку). Дальше сверка раз в WATCH_NTP_INTERVAL_MIN минут. Поправка меньше 2 секунд
            не применяется. Пояс остаётся прежним (от телефона или из Settings): SNTP даёт только UTC.

    config WATCH_NTP_SERVER
        string "NTP-сервер"
        depends on WATCH_NTP
        default "pool.ntp.org"
        help
            Запасные серверы: time.google.com и time.cloudflare.com.

    config WATCH_NTP_INTERVAL_MIN
        int "Период сверки времени, минут"
        depends on WATCH_NTP
        default 60
        range 5 1440

endmenu
```
